#include "roBa.dtsi"

&kscan0 {
        col-gpios
            = <&gpio0 19 GPIO_ACTIVE_HIGH>
            , <&gpio0 28 GPIO_ACTIVE_HIGH> 
            , <&gpio1 1 GPIO_ACTIVE_HIGH> 
            , <&gpio0 29 GPIO_ACTIVE_HIGH> 
            , <&gpio0 9 GPIO_ACTIVE_HIGH>
            , <&gpio0 4 GPIO_ACTIVE_HIGH>
            ;
        row-gpios
            = <&gpio0 10 (GPIO_ACTIVE_HIGH | GPIO_PULL_DOWN)>
            , <&gpio0 5 (GPIO_ACTIVE_HIGH | GPIO_PULL_DOWN)>
            , <&gpio0 31 (GPIO_ACTIVE_HIGH | GPIO_PULL_DOWN)>
            , <&gpio1 11 (GPIO_ACTIVE_HIGH | GPIO_PULL_DOWN)>
            ;
        };